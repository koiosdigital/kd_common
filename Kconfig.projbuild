## Kconfig.projbuild
```kconfig
menu "KD Common Configuration"

    config KD_COMMON_DEVICE_NAME_PREFIX
        string "Device name prefix"
        default "KDCOMMON"
        help
            Prefix used for generating the device name. The full device name
            will be PREFIX-XXXXXXXXXXXX where X is the MAC address in hex.

    config KD_COMMON_CRYPTO_ENABLE
        bool "Enable crypto/certificate functionality"
        default y
        depends on SOC_DIG_SIGN_SUPPORTED
        help
            Enable cryptographic functionality including device certificates,
            CSR generation, and DS peripheral signing. Requires DS peripheral
            support on the target chip.

    config KD_COMMON_API_ENABLE
        bool "Enable HTTP API server"
        default y
        help
            Enable the built-in HTTP API server for device control and
            status endpoints.

    config KD_COMMON_API_HTTPD_TASK_STACK_SIZE
        int "HTTP API task stack size"
        depends on KD_COMMON_API_ENABLE
        default 8192
        help
            Stack size for the HTTP API server task. Increase if you encounter
            stack overflow issues.

    config KD_COMMON_API_LOG_REQUESTS
        bool "Log every HTTP API request (method, URI, result, free heap)"
        depends on KD_COMMON_API_ENABLE
        default n
        help
            When enabled, the kd_common API shim logs one INFO line per
            handled request with method, URI, handler result, and free heap
            after the handler returns. Intended for heap-leak triage; keep
            disabled in production to avoid log noise on the hot path.

    choice KD_COMMON_MALLOC_TARGET
        prompt "Large buffer allocation target"
        default KD_COMMON_MALLOC_INTERNAL
        help
            Select where large buffers (BLE protocol, certs, etc.) are allocated.
            Internal is always available. SPIRAM requires PSRAM to be enabled.

        config KD_COMMON_MALLOC_INTERNAL
            bool "Internal RAM"

        config KD_COMMON_MALLOC_SPIRAM
            bool "SPIRAM"
            depends on SPIRAM

    endchoice

    config KD_COMMON_CONSOLE_ENABLE
        bool "Enable console commands"
        default y
        help
            Enable console command registration and execution via UART
            and BLE provisioning endpoints.

    menu "Provisioning Configuration"

        config KD_COMMON_SRP_USERNAME
            string "SRP Username"
            default "koiosdigital"
            help
                Username used for SRP authentication during BLE provisioning.

        choice KD_COMMON_SRP_PASSWORD_FORMAT
            prompt "SRP Password Format"
            default KD_COMMON_SRP_FORMAT_NUMERIC_6
            help
                Select the password format for SRP authentication.

            config KD_COMMON_SRP_FORMAT_STATIC
                bool "Static password"
                help
                    Use a fixed password string defined in configuration.

            config KD_COMMON_SRP_FORMAT_NUMERIC_6
                bool "6-digit numeric (0-9)"
                help
                    Generate a random 6-digit password using digits 0-9.

            config KD_COMMON_SRP_FORMAT_NUMERIC_6_REDUCED
                bool "6-digit numeric (0-5)"
                help
                    Generate a random 6-digit password using digits 0-5.

            config KD_COMMON_SRP_FORMAT_NUMERIC_4
                bool "4-digit numeric (0-9)"
                help
                    Generate a random 4-digit password using digits 0-9.

        endchoice

        config KD_COMMON_SRP_STATIC_PASSWORD
            string "Static SRP Password"
            default "koiosdigital"
            depends on KD_COMMON_SRP_FORMAT_STATIC
            help
                The static password to use for SRP authentication when
                static password format is selected.

    endmenu

    menu "Ethernet Configuration"

        config KD_COMMON_ETH_ENABLE
            bool "Enable SPI Ethernet"
            default n
            select ETH_ENABLED
            select ETH_USE_SPI_ETHERNET
            help
                Bring up a SPI Ethernet controller at boot. When a link and
                DHCP lease are acquired within the configured timeout, WiFi and
                BLE provisioning are skipped entirely and the device runs over
                Ethernet. Otherwise it falls back to WiFi/BLE provisioning.

        choice KD_COMMON_ETH_DRIVER
            prompt "Ethernet controller"
            depends on KD_COMMON_ETH_ENABLE
            default KD_COMMON_ETH_DRIVER_W6100
            help
                Select the SPI Ethernet controller fitted on the board.

            config KD_COMMON_ETH_DRIVER_W6100
                bool "WIZnet W6100"
                help
                    WIZnet W6100 SPI Ethernet controller (espressif/w6100
                    managed component).

        endchoice

        choice KD_COMMON_ETH_SPI_HOST
            prompt "SPI host"
            depends on KD_COMMON_ETH_ENABLE
            default KD_COMMON_ETH_SPI_HOST_3
            help
                SPI peripheral driving the Ethernet controller. Must not clash
                with other SPI users on the board (e.g. the FPGA loader).

            config KD_COMMON_ETH_SPI_HOST_2
                bool "SPI2"

            config KD_COMMON_ETH_SPI_HOST_3
                bool "SPI3"

        endchoice

        config KD_COMMON_ETH_SPI_CLOCK_MHZ
            int "SPI clock (MHz)"
            depends on KD_COMMON_ETH_ENABLE
            range 5 33
            default 25
            help
                SPI clock speed for the Ethernet controller. The W6100
                supports up to 33 MHz; reduce if signal integrity is poor.

        config KD_COMMON_ETH_PIN_SCK
            int "SCK GPIO"
            depends on KD_COMMON_ETH_ENABLE
            default 12

        config KD_COMMON_ETH_PIN_MOSI
            int "MOSI GPIO"
            depends on KD_COMMON_ETH_ENABLE
            default 11

        config KD_COMMON_ETH_PIN_MISO
            int "MISO GPIO"
            depends on KD_COMMON_ETH_ENABLE
            default 13

        config KD_COMMON_ETH_PIN_CS
            int "CS GPIO"
            depends on KD_COMMON_ETH_ENABLE
            default 10

        config KD_COMMON_ETH_PIN_RST
            int "Reset GPIO"
            depends on KD_COMMON_ETH_ENABLE
            default 9
            help
                Controller hardware reset line (active low). Set to -1 if the
                reset pin is not wired to the ESP32.

        config KD_COMMON_ETH_PIN_INT
            int "Interrupt GPIO"
            depends on KD_COMMON_ETH_ENABLE
            default 14
            help
                Controller interrupt line. The driver runs in interrupt mode.

        config KD_COMMON_ETH_LINK_TIMEOUT_MS
            int "Link/DHCP wait timeout (ms)"
            depends on KD_COMMON_ETH_ENABLE
            default 8000
            help
                How long to wait for Ethernet link plus a DHCP lease at boot
                before falling back to WiFi/BLE provisioning.

    endmenu

endmenu
```
